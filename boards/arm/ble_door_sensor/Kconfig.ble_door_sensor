## boards/arm/ble_door_sensor/Kconfig.defconfig
```kconfig
if BOARD_BLE_DOOR_SENSOR

config BOARD
	default "ble_door_sensor"

config HAS_BT_CTLR
	default BT

endif # BOARD_BLE_DOOR_SENSOR
```

## boards/arm/ble_door_sensor/board.yml
```yaml
# Copyright (c) 2024 Nordic Semiconductor ASA
# SPDX-License-Identifier: Apache-2.0

board:
  name: ble_door_sensor
  full_name: BLE Door Sensor
  vendor: arm
  socs:
    - name: nrf52832
```

## boards/gumulka/ble_door_sensor/Kconfig.ble_door_sensor
```kconfig
# SPDX-License-Identifier: Apache-2.0

config BOARD_BLE_DOOR_SENSOR
	select SOC_NRF52832_QFAA
```

## boards/gumulka/ble_door_sensor/Kconfig.defconfig
```kconfig
if BOARD_BLE_DOOR_SENSOR

config BT_CTLR
	default BT

endif # BOARD_BLE_DOOR_SENSOR
```

## drivers/bthome_sensors/Kconfig
```kconfig
module = BTHOME_SENSORS
module-str = bthome-sensors
source "subsys/logging/Kconfig.template.log_config"

rsource "Kconfig.light"
```

## drivers/bthome_sensors/Kconfig.battery
```kconfig
config BTHOME_BATTERY_SENSOR
	bool "Battery sensor"
	default y
	depends on DT_HAS_BTHOME_BATTERY_ENABLED
        select ADC
	help
	  Battery sensor for BTHome

if BTHOME_BATTERY_SENSOR

config BTHOME_BATTERY_SENSOR_UPDATE_INTERVAL
	int "Update interval"
	default 3600
	help
	  Interval between battery sensor updates in seconds.

endif
```

## drivers/bthome_sensors/Kconfig.button
```kconfig
config BTHOME_BUTTON_SENSOR
	bool "Button sensor"
	default y
	depends on DT_HAS_BTHOME_BUTTON_ENABLED
        select GPIO
	help
	  Button sensor for BTHome

if BTHOME_BUTTON_SENSOR

config BTHOME_BUTTON_SENSOR_EVENT_DURATION
	int "event duration"
	default 60
	help
	  How long to send the event data with BTHome before ideling again.
	  Value is in seconds.

config BTHOME_BUTTON_SENSOR_LONG_PRESS
	int "long press"
	default 2500
	help
	  How long to press the button before registering LONG_PRESS
	  Value is in ms.

config BTHOME_BUTTON_SENSOR_IDLE_TIME
	int "idle time"
	default 1000
	help
	  How long can the button be idle, before sending out the data.
	  Value is in ms.

	  If the time is really short, then pressing the button will have
	  immediate effects on the BLE data, but double or tripple press
	  become impossible. Long values result in a long time until the
	  button press is propageted to BLE, but double or tripple presses
	  become easier to do.

endif
```

## drivers/bthome_sensors/Kconfig.light
```kconfig
config BTHOME_LIGHT_SENSOR
	bool "Light sensor"
	default y
	depends on DT_HAS_PHOTOTRANSISTOR_SPECIAL_ENABLED
	select GPIO
        select ADC
	help
	  My very own special Phototransistor configuration.

if BTHOME_LIGHT_SENSOR

config BTHOME_LIGHT_SENSOR_UPDATE_INTERVAL
	int "Update interval"
	default 600
	help
	  Interval between light sensor updates in seconds.

endif
```

## drivers/bthome_sensors/Kconfig.temp-humidity
```kconfig
config BTHOME_TEMP_HUMIDITY_SENSOR
	bool "Temperature & Humidity sensor"
	default y
	depends on DT_HAS_BTHOME_TEMP_HUMIDITY_ENABLED
        select SENSOR
	help
	  Temperature & Humidity sensor for BTHome

if BTHOME_TEMP_HUMIDITY_SENSOR

config BTHOME_TEMP_HUMIDITY_SENSOR_UPDATE_INTERVAL
	int "Update interval"
	default 1200
	help
	  Interval between Temperature & Humidity sensor updates in seconds.

endif
```

## dts/bindings/sensor/bthome-battery.yaml
```yaml
# Copyright (c) 2026 Fabian Pflug
# SPDX-License-Identifier: Apache-2.0

description: Battery sensor for BTHome

compatible: "bthome-battery"

include: base.yaml

properties:
  io-channels:
    required: true
    description: |
      ADC IO channel to measure the battery voltage.

  voltage-full:
    type: int
    required: true
    description: Voltage if the battery if full in mV

  voltage-empty:
    type: int
    required: true
    description: Voltage if the battery if empty in mV
```

## dts/bindings/sensor/bthome-button.yaml
```yaml
# Copyright (c) 2026 Fabian Pflug
# SPDX-License-Identifier: Apache-2.0

description: GPIO Input for button event sensor in BTHome

compatible: "bthome-button"

include: base.yaml

properties:
  input-gpios:
    type: phandle-array
    required: true
    description: |
      GPIO to use for interrupt detection
```

## dts/bindings/sensor/bthome-gpio-input.yaml
```yaml
# Copyright (c) 2026 Fabian Pflug
# SPDX-License-Identifier: Apache-2.0

description: GPIO Input for binary sensor in BTHome

compatible: "bthome-binary-gpio"

include: base.yaml

properties:
  input-gpios:
    type: phandle-array
    required: true
    description: |
      GPIO to use for interrupt detection

  bthome-sensor-type:
    type: int
    default: 0x2D
    description: |
      The sensor type acording to the bthome specification
      Must be a binary sensor
```

## dts/bindings/sensor/bthome-temp-humidity.yaml
```yaml
# Copyright (c) 2026 Fabian Pflug
# SPDX-License-Identifier: Apache-2.0

description: Temperature & Humidity sensor for BTHome

compatible: "bthome-temp-humidity"

include: base.yaml

properties:
  sensor:
    type: phandle
    required: true
    description: |
      The temperature and humidity sensor device

  include-temperature:
    type: boolean
    description: include the temperature as a BTHome output

  include-humidity:
    type: boolean
    description: include the humidity as a BTHome output
```

## dts/bindings/sensor/energy-tracker.yaml
```yaml
# Copyright (c) 2026 Fabian Pflug
# SPDX-License-Identifier: Apache-2.0

description: |
  A kind of special configuration for my device, where I use the comperator
  to track LED blibs of my energy meter by physically modifying the
  ble_door_sensor with a 1M and 22k resistor to have a reference. Not sure if
  I ever upstream it, but it is kind of generic, except, that is has an enable
  GPIO and is only used to feed the BTHome information.

compatible: "energy-tracker-special"

include: base.yaml

properties:
  comp:
    type: phandle
    required: true
    description: |
      The comperator device

  enable-gpios:
    type: phandle-array
    required: true
    description: |
      GPIO to use to enable/disable the phototransistor. This GPIO is driven
      active when the phototransistor is enabled and inactive when the
      phototransistor is disabled.

  include-calculated-power:
    type: boolean
    description: include the calculated power as a BTHome output

  include-energy:
    type: boolean
    description: include the consumed energy as a BTHome output
```

## dts/bindings/sensor/phototransistor-special.yaml
```yaml
# Copyright (c) 2024 Fabian Pflug
# SPDX-License-Identifier: Apache-2.0

description: Generic Phototransistor

compatible: "phototransistor-special"

include: [sensor-device.yaml]

properties:
  io-channels:
    required: true
    description: |
      ADC IO channel connected to this phototransistor.

  pulldown-ohm:
    type: int
    required: true
    description: |
      The pulldown resistance in the circuit.

  enable-gpios:
    type: phandle-array
    required: true
    description: |
      GPIO to use to enable/disable the phototransistor. This GPIO is driven
      active when the phototransistor is enabled and inactive when the
      phototransistor is disabled.
```

## lib/bthome/Kconfig
```kconfig
# Copyright (c) 2024 Nordic Semiconductor ASA
# SPDX-License-Identifier: Apache-2.0

menuconfig BTHOME
	bool "BTHome BLE support"
	select BT_BROADCASTER
	select BT_HCI_HOST
	help
	  Export BTHome sensors over BLE

if BTHOME

config BTHOME_STACK_SIZE
	int "Update sensor thread stack size"
	default 1024
	help
	  The stack size for the update sensor thread

config BTHOME_SERVICE_UUID
	hex "Service UUID"
	default 0xfcd2
	help
	  The UUID of the BTHome service.

config BTHOME_FAST_INTERVAL
	hex "ADV interval for events"
	default 0x0400
	help
	  The advertisement interval for events.
	  default is 0x0400 * 0.625ms = 1024 * 0.625ms = 0.64 s

config BTHOME_NORMAL_INTERVAL
	hex "ADV interval for normal Operation"
	default 0x4000
	help
	  The advertisement interval for normal operation.
	  default is the same as BT_LE_ADV_INTERVAL_MAX, which is
	  0x4000 * 0.625ms = 16384 * 0.625ms = 10.24 s
	  It is used to conserve energy as much as possible, as data will
	  probably not change rapidly.

config BTHOME_BLINK_LED
	bool "Blink LED on sensor updates"
	default y
	help
	  Should led0 be used to blink if sensors are updated.

module = BTHOME
module-str = bthome
source "subsys/logging/Kconfig.template.log_config"

endif
```

## west.yml
```yaml
# Copyright (c) 2024 Fabian Pflug
# SPDX-License-Identifier: Apache-2.0

manifest:
  self:
    path: ble_door_sensor

  remotes:
    - name: zephyrproject-rtos
      url-base: https://github.com/zephyrproject-rtos

  projects:
    - name: zephyr
      remote: zephyrproject-rtos
      revision: v4.4.1
      import:
        name-allowlist:
          - cmsis_6
          - hal_nordic
          - zcbor
          - mcuboot
```
