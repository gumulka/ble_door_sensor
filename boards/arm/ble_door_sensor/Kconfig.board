## boards/arm/ble_door_sensor/Kconfig.board
```kconfig
config BOARD_BLE_DOOR_SENSOR
	bool "BLE door sensor"
	depends on SOC_NRF52832_QFAA
```

## boards/arm/ble_door_sensor/ble_door_sensor_defconfig
```kconfig
CONFIG_SOC_SERIES_NRF52X=y
CONFIG_SOC_NRF52832_QFAA=y
CONFIG_BOARD_BLE_DOOR_SENSOR=y

# Enable MPU
CONFIG_ARM_MPU=y

# Use internal oscillator
CONFIG_CLOCK_CONTROL_NRF_K32SRC_RC=y
```

## boards/gumulka/ble_door_sensor/ble_door_sensor_defconfig
```kconfig
# Enable MPU
CONFIG_ARM_MPU=y

# Use internal oscillator
CONFIG_CLOCK_CONTROL_NRF_K32SRC_RC=y
```
